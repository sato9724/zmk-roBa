## config/boards/shields/roBa/Kconfig.defconfig
```kconfig
if SHIELD_ROBA_L || SHIELD_ROBA_R

config ZMK_KEYBOARD_NAME
    default "roBa"

config ZMK_SPLIT_BLE_CENTRAL_BATTERY_LEVEL_FETCHING
    default y

config ZMK_SPLIT_BLE_CENTRAL_BATTERY_LEVEL_PROXY
    default y

endif
```
